## build/conf/local.conf
```bitbake
LICENSE_FLAGS_WHITELIST = "commercial"
MACHINE ??= "tinker-rk3288"
DEFAULTTUNE = "cortexa17hf-neon-vfpv4"
DISTRO ?= 'rk-none'
PACKAGE_CLASSES ?= 'package_deb'
EXTRA_IMAGE_FEATURES ?= "debug-tweaks"
USER_CLASSES ?= "buildstats image-mklibs image-prelink"
PATCHRESOLVE = "noop"
BB_DISKMON_DIRS = "\
    STOPTASKS,${TMPDIR},1G,100K \
    STOPTASKS,${DL_DIR},1G,100K \
    STOPTASKS,${SSTATE_DIR},1G,100K \
    STOPTASKS,/tmp,100M,100K \
    ABORT,${TMPDIR},100M,1K \
    ABORT,${DL_DIR},100M,1K \
    ABORT,${SSTATE_DIR},100M,1K \
    ABORT,/tmp,10M,1K"
PACKAGECONFIG_append_pn-qemu-native = " sdl"
PACKAGECONFIG_append_pn-nativesdk-qemu = " sdl"
CONF_VERSION = "1"

DL_DIR ?= "${BSPDIR}/downloads/"

CORE_IMAGE_EXTRA_INSTALL += " rockchip-mali"
BB_NUMBER_THREADS = '4'
PARALLEL_MAKE = '-j 6'

DISTRO_FEATURES_remove = "x11 wayland"
PACKAGECONFIG_GL_pn-qtbase = "gles2"

CORE_IMAGE_EXTRA_INSTALL += " gcc g++ binutils libgcc libgcc-dev libstdc++ libstdc++-dev libstdc++-staticdev \
autoconf automake ccache chkconfig glib-networking glibmm \
packagegroup-core-buildessential pkgconfig cpufrequtils dpkg cronie \
boost cmake zlib glib-2.0 git i2c-tools python-scons \
    gstreamer1.0 \
    gstreamer1.0-plugins-base \
    gstreamer1.0-plugins-good \
    gstreamer1.0-plugins-bad \
    gstreamer1.0-plugins-ugly \
    gstreamer1.0-dev \
    rockchip-mpp \
    gstreamer1.0-rockchip \
    openssh \
    openssh-sftp-server \
    cairo pango fontconfig freetype \
    live555 \
    v4l-utils \
    opencv \
    ffmpeg \
    nodejs \
    rockchip-mali \
    openssh-sftp-server \
    make \
    icu \
    qtbase \
    qtdeclarative \
    qtdeclarative-tools \
    qtdeclarative-qmlplugins \
    qtmultimedia \
    qtmultimedia-plugins \
    qtmultimedia-qmlplugins \
    qtsvg \
    qtsvg-plugins \
    qtx11extras \
    qtsensors \
    qtserialport \
    qtimageformats-plugins \
    qtsystems \
    qtsystems-tools \
    qtsystems-qmlplugins \
    qtscript \
    qtwebkit \
    qtwebkit-examples-examples \
    qtwebkit-qmlplugins \
    qt3d \
    qt3d-qmlplugins \
    qt3d-tools \
    cinematicexperience \
    qtsmarthome \
    qt5everywheredemo \ 
    qt5nmapcarousedemo \
    qt5nmapper \
    quitindicators \
    quitbattery \
    qt5ledscreen \
    "

IMAGE_INSTALL_append += "kernel-modules"
```

## sources/meta-rockchip-extra/conf/distro/include/rk-base.inc
```bitbake
require conf/distro/poky.conf

DISTRO = "rk-base"
DISTRO_NAME = "Rockchip Distro Base"
SDK_VENDOR = "-rksdk"

MAINTAINER = "Jacob Chen <jacob2.chen@rock-chips.com>"

TARGET_VENDOR = "-rk"

DISTROOVERRIDES = "rockchip"

# Rockchip BSP default settings

VIRTUAL-RUNTIME_init_manager = "systemd"

PREFERRED_VERSION_libdrm = "rk"
PREFERRED_VERSION_xserver-xorg = "rk"
PREFERRED_VERSION_xserver-nodm-init = "2.0"
XSERVER ?= "xserver-xorg \
		   xf86-input-libinput \
		   xf86-video-modesetting"

PREFERRED_PROVIDER_virtual/egl = "rockchip-mali"
PREFERRED_PROVIDER_virtual/libgles1 = "rockchip-mali"
PREFERRED_PROVIDER_virtual/libgles2 = "rockchip-mali"
PREFERRED_PROVIDER_virtual/libopencl = "rockchip-mali"

DEFAULTTUNE_rk3036="cortexa7hf-neon-vfpv4"
DEFAULTTUNE_rk3288="cortexa17hf-neon-vfpv4"
DEFAULTTUNE_rk3328="aarch64"
DEFAULTTUNE_rk3399="aarch64"

LICENSE_FLAGS_WHITELIST="commercial"
```

## sources/meta-rockchip-extra/conf/distro/rk-xwayland.conf
```bitbake
require conf/distro/include/rk-base.inc

DISTRO = "rk-xwayland"
DISTRO_NAME = "Rockchip XWayland"

DISTRO_FEATURES_append += " x11 wayland systemd"

PREFERRED_VERSION_xserver-xorg = ""
```

## sources/meta-rockchip-extra/demo/meta-player-qt/conf/layer.conf
```bitbake
# Copyright (C) 2017 Fuzhou Rockchip Electronics Co., Ltd
# Released under the MIT license (see COPYING.MIT for the terms)

# We have a conf and classes directory, add to BBPATH
BBPATH .= ":${LAYERDIR}"

# We have recipes-* directories, add to BBFILES
BBFILES += "${LAYERDIR}/*.bb ${LAYERDIR}/*.bbappend"

BBFILE_COLLECTIONS += "rockchip_player_qt"
BBFILE_PATTERN_rockchip_player_qt = "^${LAYERDIR}/"
BBFILE_PRIORITY_rockchip_player_qt = "1"

# This should only be incremented on significant changes that will
# cause compatibility issues with other layers
LAYERVERSION_rockchip_player_qt = "1"

LAYERDEPENDS_rockchip_player_qt = "core"
LICENSE_PATH += "${LAYERDIR}/licenses"
```

## sources/meta-rockchip/conf/layer.conf
```bitbake
# Copyright (C) 2014 NEO-Technologies
# Released under the MIT license (see COPYING.MIT for the terms)

# We have a conf and classes directory, add to BBPATH
BBPATH .= ":${LAYERDIR}"

# We have recipes-* directories, add to BBFILES
BBFILES += "${LAYERDIR}/recipes-*/*/*.bb ${LAYERDIR}/recipes-*/*/*.bbappend"

BBFILE_COLLECTIONS += "rockchip"
BBFILE_PATTERN_rockchip = "^${LAYERDIR}/"
BBFILE_PRIORITY_rockchip = "1"

# This should only be incremented on significant changes that will
# cause compatibility issues with other layers
LAYERVERSION_rockchip = "1"

LAYERDEPENDS_rockchip = "core"
LICENSE_PATH += "${LAYERDIR}/licenses"

# The .bbappend and .bb files are included if the respective layer
# collection is available.
BBFILES += "${@' '.join('${LAYERDIR}/dynamic-layers/%s/recipes*/*/*.bbappend' % layer \
               for layer in BBFILE_COLLECTIONS.split())}"
BBFILES += "${@' '.join('${LAYERDIR}/dynamic-layers/%s/recipes*/*/*.bb' % layer \
               for layer in BBFILE_COLLECTIONS.split())}"
```

## sources/meta-rockchip/conf/machine/evb-rk3328.conf
```bitbake
# Copyright (C) 2017 Fuzhou Rockchip Electronics Co., Ltd
# Released under the MIT license (see COPYING.MIT for the terms)

#@TYPE: Machine
#@NAME: EVB 3399

include conf/machine/include/rk3328.inc

KERNEL_DEVICETREE = "rockchip/rk3328-evb.dtb"
UBOOT_MACHINE = "evb-rk3328_defconfig"
```

## sources/meta-rockchip/conf/machine/excavator-rk3399.conf
```bitbake
# Copyright (C) 2017 Fuzhou Rockchip Electronics Co., Ltd
# Released under the MIT license (see COPYING.MIT for the terms)

#@TYPE: Machine
#@NAME: EXCAVATOR 3399

include conf/machine/include/rk3399.inc

KERNEL_DEVICETREE = "rockchip/rk3399-sapphire-excavator-linux.dtb"
UBOOT_MACHINE = "evb-rk3399_defconfig"
```

## sources/meta-rockchip/conf/machine/firefly-rk3399.conf
```bitbake
# Copyright (C) 2017 Fuzhou Rockchip Electronics Co., Ltd
# Released under the MIT license (see COPYING.MIT for the terms)

#@TYPE: Machine
#@NAME: Firefly RK3399
#@DESCRIPTION: Firefly-RK3399 is a Six-Core 64-bit High-Performance Platform.
#http://www.t-firefly.com/en/

include conf/machine/include/rk3399.inc

KERNEL_DEVICETREE = "rockchip/rk3399-firefly-linux.dtb"
UBOOT_MACHINE = "firefly-rk3399_defconfig"
```

## sources/meta-rockchip/conf/machine/include/rk3036.inc
```bitbake
# Copyright (C) 2017 Jacob Chen
# Released under the MIT license (see COPYING.MIT for the terms)

SOC_FAMILY = "rk3036"

require conf/machine/include/tune-cortexa7.inc
require conf/machine/include/soc-family.inc

PREFERRED_PROVIDER_virtual/kernel = "linux-rockchip"
PREFERRED_VERSION_linux-rockchip = "4.4"

SERIAL_CONSOLES = "115200;ttyS2"
KERNEL_IMAGETYPE = "zImage"
KBUILD_DEFCONFIG = "rockchip_linux_defconfig"

PREFERRED_PROVIDER_virtual/bootloader ?= "u-boot-rockchip"
SPL_BINARY ?= "u-boot-spl-nodtb.bin"

IMAGE_FSTYPES += "ext4 rockchip-gpt-img"
IMAGE_CLASSES += "rockchip-gpt-img"
```

## sources/meta-rockchip/conf/machine/include/rk3288.inc
```bitbake
# Copyright (C) 2015 Romain Perier
# Released under the MIT license (see COPYING.MIT for the terms)

SOC_FAMILY = "rk3288"

require conf/machine/include/tune-cortexa17.inc
require conf/machine/include/soc-family.inc

PREFERRED_PROVIDER_virtual/kernel = "linux-rockchip"
PREFERRED_VERSION_linux-rockchip = "4.4"

SERIAL_CONSOLES = "115200;ttyS2"
KERNEL_IMAGETYPE = "zImage"
KBUILD_DEFCONFIG = "rockchip_linux_defconfig"

PREFERRED_PROVIDER_virtual/bootloader ?= "u-boot-rockchip"
SPL_BINARY ?= "u-boot-spl-dtb.bin"

IMAGE_FSTYPES += "rockchip-gpt-img"
IMAGE_CLASSES += "rockchip-gpt-img rockchip-update-img"
```

## sources/meta-rockchip/conf/machine/include/rv1108.inc
```bitbake
# Copyright (C) 2017 Fuzhou Rockchip Electronics Co., Ltd
# Released under the MIT license (see COPYING.MIT for the terms)

SOC_FAMILY = "rv1108"

require conf/machine/include/tune-cortexa7.inc
require conf/machine/include/soc-family.inc

PREFERRED_PROVIDER_virtual/kernel = "linux-rockchip"
PREFERRED_VERSION_linux-rockchip = "3.10"

SERIAL_CONSOLES = "1500000;ttyS2"
KERNEL_IMAGETYPE = "zImage"
KBUILD_DEFCONFIG = "rockchip_linux_defconfig"
```
